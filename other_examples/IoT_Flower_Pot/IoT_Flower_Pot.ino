#include <SPI.h>
#include <Wire.h>
#include <Adafruit_GFX.h>
#include <Adafruit_SSD1306.h>
#include <ESP8266WiFi.h>

const char* network = "cat6";  
const char* password = "00000000";
String site = "api.openweathermap.org";

#define OLED_RESET LED_BUILTIN
Adafruit_SSD1306 display(OLED_RESET);

static const unsigned char PROGMEM partly_cloud [] = {
0x00, 0x00, 0x00, 0x00, 0x00, 0x00, 0x00, 0x00, 0x00, 0x00, 0x00, 0x00, 0x00, 0x00, 0x00, 0x00,
0x00, 0x00, 0x00, 0x00, 0x00, 0x00, 0x01, 0x08, 0x00, 0x00, 0x00, 0x01, 0x08, 0x00, 0x00, 0x00,
0x00, 0x88, 0x40, 0x00, 0x00, 0x00, 0x88, 0x40, 0x00, 0x00, 0x00, 0x48, 0x80, 0x00, 0x00, 0x00,
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0x00, 0x00, 0x00, 0x00, 0x00, 0x00, 0x00, 0x00, 
};
static const unsigned char PROGMEM rain_cloud [] = {
0x00, 0x00, 0x00, 0x00, 0x00, 0x00, 0x00, 0x00, 0x00, 0x00, 0x00, 0x00, 0x7E, 0x00, 0x00, 0x00,
0x01, 0x81, 0x80, 0x00, 0x00, 0x02, 0x00, 0x40, 0x00, 0x00, 0x04, 0x00, 0x20, 0x00, 0x00, 0x08,
0x00, 0x10, 0x00, 0x00, 0x10, 0x00, 0x08, 0x00, 0x00, 0x10, 0x00, 0x08, 0x00, 0x00, 0x20, 0x00,
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0x00, 0x00, 0x00, 0x00, 0x00, 0x00, 0x00, 0x00, 
};
static const unsigned char PROGMEM sun [] = {
0x00, 0x00, 0x00, 0x00, 0x00, 0x00, 0x00, 0x00, 0x00, 0x00, 0x00, 0x00, 0x00, 0x00, 0x00, 0x00,
0x00, 0x10, 0x00, 0x00, 0x00, 0x00, 0x10, 0x00, 0x00, 0x00, 0x00, 0x10, 0x00, 0x00, 0x00, 0x00,
0x10, 0x00, 0x00, 0x00, 0x00, 0x10, 0x00, 0x00, 0x00, 0x00, 0x10, 0x00, 0x80, 0x01, 0x00, 0x10,
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0x00, 0x00, 0x00, 0x00, 0x00, 0x00, 0x00, 0x00, 
};
static const unsigned char PROGMEM humidity [] = {
0x00, 0x00, 0x00, 0x00, 0x00, 0x00, 0x00, 0x0C, 0x00, 0x00, 0x00, 0x00, 0x0C, 0x00, 0x00, 0x00,
0x00, 0x1E, 0x00, 0x00, 0x00, 0x00, 0x1E, 0x00, 0x00, 0x00, 0x00, 0x3E, 0x00, 0x00, 0x00, 0x00,
0x7F, 0x00, 0x00, 0x00, 0x00, 0x7F, 0x00, 0x00, 0x00, 0x00, 0x7F, 0x00, 0x00, 0x00, 0x00, 0xFF,
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0x00, 0x00, 0x00, 0x00, 0x00, 0x00, 0x00, 0x00, 
};

WiFiClient client;
String answer,stempk,wind,humi,des;
int tempk, tempc, postemp,poswind,poshumi,posdes,valhumi;

#if (SSD1306_LCDHEIGHT != 64)
#error("Height incorrect, please fix Adafruit_SSD1306.h!");
#endif

void setup() {
  //Serial.begin(115200);
  pinMode(D3,OUTPUT);
  pinMode(D6,INPUT);
  display.begin(SSD1306_SWITCHCAPVCC, 0x3C);
  display.clearDisplay();
  display.setTextColor(WHITE);

  WiFi.begin(network, password);
  display.setTextSize(1);
  display.setCursor(0,30);
  display.print("Waiting connection to the router...");
  display.display();
  while (WiFi.status() != WL_CONNECTED){
    delay(500);
  }
    display.clearDisplay();
    display.setTextSize(2);
    display.setCursor(10,20);
    display.print("Connected");
    display.display();
    delay(5000);
}

void loop() {
    wifistat();
    weather();
    if(des.indexOf("rain") != -1){
      temp(rain_cloud,String(tempc),des,wind,humi);
    }else if (des.indexOf("clouds") != -1){
      if(des=="scattered clouds"){
        temp(partly_cloud,String(tempc),"most clouds",wind,humi);
      }else{
        temp(partly_cloud,String(tempc),des,wind,humi);
      }
    }else{
      temp(sun,String(tempc),des,wind,humi);
    }
    delay(20000);
    for(int i = 0;i <4;i++){
      soil();
      //delay(1000); 
    } 
}

void weather(){
    while (!client.connect(site.c_str(), 80)){
      display.clearDisplay();
      display.setTextSize(1);
      display.setCursor(0,30);
      display.print("Waiting connection with the server...");
      display.display();
      delay(500);
    }
    if (client.connect(site.c_str(), 80)){
      client.print("GET /data/2.5/weather?");
      client.print("id=");
      client.print(1830103); //1830103
      client.print("&APPID=8ebc663c25dd6ec27c6c767698031ba6 ");
      client.print("HTTP/1.0\r\n");
      client.print("Host: " + site + "\r\n\r\n");
      client.print("Connection: close");
      while (!client.available()){
        display.clearDisplay();
        display.setTextSize(1);
        display.setCursor(0,30);
        display.print("Waiting server answer...");
        display.display();
        delay(500);
      }
      while (client.available()){//Read the answer of the API and keep the data on the string answer
        char c = client.read();
        answer += c;
      }
      //Serial.println(answer);
    }
    postemp = answer.indexOf("temp");
    stempk = answer.substring(postemp + 6, postemp + 13);
    tempk = stempk.toInt();
    tempc = tempk - 273;

    poswind = answer.indexOf("wind");
    wind = answer.substring(poswind + 15, poswind + 18);

    poshumi = answer.indexOf("humidity");
    humi = answer.substring(poshumi + 10, poshumi + 12);
    valhumi = humi.toInt();

    posdes = answer.indexOf("description");
    int ind = answer.indexOf(",",posdes);
    des = answer.substring(posdes + 14, ind - 1);
    
    stempk = "";
    answer = "";
}

void temp(const uint8_t *bitmap,String t,String des,String w,String h){
  display.clearDisplay(); 
    //Image
  display.drawBitmap(0,0,bitmap,40,40,WHITE);
    //temperature
  display.setTextSize(3);
  display.setCursor(0,42);
  display.print(t);
  display.setCursor(35,35);
  display.write(9);
  display.setCursor(53,42);
  display.print("C");
    //description
  display.setTextSize(1);
  display.setCursor(42,5);
  display.print(des);
    //Wind
  display.setTextSize(1);
  display.setCursor(77,20);
  display.print("Wind");
  display.setCursor(80,30);
  display.print(w+String(" m/s"));
    //Humidity
  display.setTextSize(1);
  display.setCursor(77,45);
  display.print("Humidity");
  display.setCursor(80,55);
  display.print(h+String("%"));
  
  display.display();
}

void wifistat(){
  if(WiFi.status() != WL_CONNECTED){
    display.clearDisplay();
    display.setTextSize(1);
    display.setCursor(0,30);
    display.print("Waiting connection to the router...");
    display.display();
    while (WiFi.status() != WL_CONNECTED){
      delay(500);
    }
    display.clearDisplay();
    display.setTextSize(2);
    display.setCursor(10,20);
    display.print("Connected");
    display.display();
    delay(5000);
  }
}

void soil(){
  int soil = analogRead(A0);
  int humi_soil = map(soil,1023,0,0,100);
  display.clearDisplay(); 
  display.drawBitmap(0,0,humidity,40,40,WHITE);
  display.setTextSize(3);
  display.setCursor(0,42);
  display.print(String(humi_soil)+"%");
  display.display();
  //if(valhumi < 50){
    if(humi_soil < 10){
      digitalWrite(D3,HIGH);
      delay(3000);
      digitalWrite(D3,LOW);
      delay(2000);
    }else{
      digitalWrite(D3,LOW);
      delay(5000);
    }
  //}
  delay(3000);
}

